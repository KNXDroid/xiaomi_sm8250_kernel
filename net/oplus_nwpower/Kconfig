## net/oplus_nwpower/Kconfig
```kconfig
# SPDX-License-Identifier: GPL-2.0-only
# Copyright (C) 2020-2022 Oplus. All rights reserved.

config OPLUS_NWPOWER
    bool "OPLUS NWPOWER"
    default y
    help
	 add for oplus wakelock_profiler
```
